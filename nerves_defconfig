## nerves_defconfig
```kconfig
BR2_arm=y
BR2_cortex_a8=y
BR2_ARM_EABIHF=y
BR2_PACKAGE_OVERRIDE_FILE="$(TOPDIR)/local.mk"
BR2_TOOLCHAIN_EXTERNAL=y
BR2_ENABLE_LOCALE_PURGE=y
BR2_ENABLE_LOCALE_WHITELIST="C en_US"
BR2_TARGET_OPTIMIZATION="-pipe"
BR2_TARGET_GENERIC_HOSTNAME=""
#BR2_TARGET_GENERIC_ROOT_PASSWD=""
BR2_TARGET_GENERIC_ISSUE=""
BR2_TARGET_GENERIC_GETTY_BAUDRATE_115200=y
#BR2_ROOTFS_USERS_TABLES="${NERVES_DEFCONFIG_DIR}/users_table.txt"
BR2_ROOTFS_OVERLAY="${NERVES_DEFCONFIG_DIR}/rootfs-additions"
BR2_ROOTFS_POST_BUILD_SCRIPT="${NERVES_DEFCONFIG_DIR}/post-build.sh"
BR2_LINUX_KERNEL=y
BR2_LINUX_KERNEL_CUSTOM_GIT=y
BR2_LINUX_KERNEL_CUSTOM_REPO_URL="https://github.com/NextThingCo/CHIP-linux.git"
BR2_LINUX_KERNEL_CUSTOM_REPO_VERSION="debian/4.4.11-ntc-1"
BR2_LINUX_KERNEL_PATCH="wext_priv.patch"
BR2_LINUX_KERNEL_USE_CUSTOM_CONFIG=y
BR2_LINUX_KERNEL_CUSTOM_CONFIG_FILE="${NERVES_DEFCONFIG_DIR}/linux.config"
BR2_LINUX_KERNEL_ZIMAGE=y
BR2_LINUX_KERNEL_DTS_SUPPORT=y
BR2_LINUX_KERNEL_INTREE_DTS_NAME="sun5i-r8-chip"
BR2_LINUX_KERNEL_INSTALL_TARGET=y
BR2_PACKAGE_BUSYBOX_CONFIG="${NERVES_DEFCONFIG_DIR}/chip-busybox.config"
#BR2_PACKAGE_ALSA_UTILS=y
#BR2_PACKAGE_ALSA_UTILS_APLAY=y
#BR2_PACKAGE_MPG123=y
#BR2_PACKAGE_SOX=y
#BR2_PACKAGE_MMC_UTILS=y
#BR2_PACKAGE_MTD=y
#BR2_PACKAGE_MTD_MKFSUBIFS=y
#BR2_PACKAGE_LSUIO=y
#BR2_PACKAGE_PCIUTILS=y
#BR2_PACKAGE_AVAHI=y
#BR2_PACKAGE_AVAHI_DAEMON=y
#BR2_PACKAGE_AVAHI_LIBDNSSD_COMPATIBILITY=y
#BR2_PACKAGE_BLUEZ_UTILS_COMPAT=y
#BR2_PACKAGE_BLUEZ_UTILS_AUDIO=y
#BR2_PACKAGE_BLUEZ_UTILS_USB=y
#BR2_PACKAGE_BLUEZ_UTILS_GATT=y
#BR2_PACKAGE_CONNMAN=y
#BR2_PACKAGE_CONNMAN_WIFI=y
#BR2_PACKAGE_CONNMAN_WISPR=y
#BR2_PACKAGE_CONNMAN_BLUETOOTH=y
#BR2_PACKAGE_CONNMAN_CLIENT=y
#BR2_PACKAGE_IPERF3=y
#BR2_PACKAGE_IPROUTE2=y
#BR2_PACKAGE_OPENOBEX=y
#BR2_PACKAGE_OPENOBEX_BLUEZ=y
#BR2_PACKAGE_OPENOBEX_LIBUSB=y
#BR2_PACKAGE_OPENOBEX_APPS=y
#BR2_PACKAGE_OPENOBEX_SYSLOG=y
#BR2_PACKAGE_OPENOBEX_DUMP=y
#BR2_PACKAGE_OPENSSH=y
BR2_PACKAGE_RTL8723BS_BT=y
BR2_PACKAGE_RTL8723BS_BT_CUSTOM_GIT=y
BR2_PACKAGE_RTL8723BS_BT_CUSTOM_REPO_URL="https://github.com/lwfinger/rtl8723bs_bt.git"
BR2_PACKAGE_RTL8723BS_BT_CUSTOM_REPO_VERSION="master"
BR2_PACKAGE_RTL8723BS_MP_DRIVER=y
BR2_PACKAGE_RTL8723BS_MP_DRIVER_CUSTOM_GIT=y
BR2_PACKAGE_RTL8723BS_MP_DRIVER_CUSTOM_REPO_URL="https://github.com/NextThingCo/RTL8723BS.git"
BR2_PACKAGE_RTL8723BS_MP_DRIVER_CUSTOM_REPO_VERSION="master"
#BR2_PACKAGE_TCPDUMP=y
#BR2_PACKAGE_WGET=y
#BR2_PACKAGE_SUDO=y
#BR2_PACKAGE_KMOD=y
#BR2_PACKAGE_KMOD_TOOLS=y
BR2_TARGET_ROOTFS_CPIO=y
BR2_TARGET_ROOTFS_UBIFS=y
BR2_TARGET_ROOTFS_UBIFS_LEBSIZE=0x1f8000
BR2_TARGET_ROOTFS_UBIFS_MINIOSIZE=0x4000
BR2_TARGET_ROOTFS_UBIFS_MAXLEBCNT=2000
BR2_TARGET_ROOTFS_UBIFS_LZO=y
BR2_TARGET_ROOTFS_UBI=y
BR2_TARGET_ROOTFS_UBI_PEBSIZE=0x200000
BR2_TARGET_ROOTFS_UBI_SUBSIZE=16384
BR2_TARGET_UBOOT=y
BR2_TARGET_UBOOT_BOARDNAME="CHIP"
BR2_TARGET_UBOOT_CUSTOM_GIT=y
BR2_TARGET_UBOOT_CUSTOM_REPO_URL="https://github.com/NextThingCo/CHIP-u-boot.git"
BR2_TARGET_UBOOT_CUSTOM_REPO_VERSION="nextthing/chip-production-v1.2"
BR2_TARGET_UBOOT_FORMAT_CUSTOM=y
BR2_TARGET_UBOOT_FORMAT_CUSTOM_NAME="u-boot-dtb.bin"
BR2_TARGET_UBOOT_SPL=y
BR2_TARGET_UBOOT_SPL_NAME="spl/sunxi-spl.bin spl/sunxi-spl-with-ecc.bin"
BR2_TARGET_UBOOT_ENVIMAGE=y
BR2_TARGET_UBOOT_ENVIMAGE_SOURCE="${NERVES_DEFCONFIG_DIR}/uboot-env"
BR2_TARGET_UBOOT_ENVIMAGE_SIZE="0x400000"
BR2_PACKAGE_HOST_DTC_OVERLAY=y
BR2_PACKAGE_HOST_SUNXI_TOOLS=y



BR2_PACKAGE_E2FSPROGS=y
BR2_PACKAGE_LINUX_FIRMWARE=y
BR2_PACKAGE_ERLANG_SMP=y
BR2_PACKAGE_OPENSSL=y
BR2_PACKAGE_LIBMNL=y
BR2_PACKAGE_NCURSES=y
BR2_PACKAGE_WPA_SUPPLICANT=y
BR2_PACKAGE_WPA_SUPPLICANT_DEBUG_SYSLOG=y
# BR2_TARGET_ROOTFS_SQUASHFS=y
BR2_NERVES_SYSTEM_NAME="nerves_system_chip"
BR2_PACKAGE_BOARDID=y
BR2_PACKAGE_ERLANG_HISTORY=y
BR2_PACKAGE_FWUP=y
BR2_PACKAGE_NERVES_CONFIG=y
BR2_PACKAGE_NERVES_CONFIG_NO_ERLINIT_CONF=y
BR2_PACKAGE_NERVES_CONFIG_ELIXIR=y
BR2_PACKAGE_NERVES_CONFIG_APPS="crypto"
BR2_PACKAGE_HOST_ERLANG_RELSYNC=y
BR2_PACKAGE_HOST_ERLANG_RELX=y
BR2_PACKAGE_HOST_FWUP=y
```
